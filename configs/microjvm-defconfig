## configs/microjvm-defconfig
```kconfig
CONFIG_SDK_USER_ENTRYPOINT="microjvm_main"
CONFIG_CXD56_SDIO=y
CONFIG_CXD56_SPI=y
CONFIG_CXD56_DMAC_SPI4_TX=y
CONFIG_CXD56_DMAC_SPI4_RX=y
CONFIG_CXD56_AUDIO=y
CONFIG_LCD=y
CONFIG_LCD_ILI9340=y
CONFIG_LCD_ILI9340_IFACE0=y
CONFIG_CXD56_GNSS=y
CONFIG_CXD56_GNSS_CEP_FILENAME="/mnt/vfat/gnss_cep.bin"
CONFIG_GPSUTILS_CXD56NMEA_LIB=y
CONFIG_SDK_AUDIO=y
CONFIG_AUDIOUTILS_PLAYER=y
CONFIG_MEMUTILS=y
CONFIG_ASMP=y
CONFIG_ASMP_MEMSIZE=0x80000
CONFIG_MICROJVM=y
CONFIG_MICROEJ_AUDIOPLAYER=y
CONFIG_MICROEJ_GNSS=y
```

## microej/Kconfig
```kconfig
#
# For a description of the syntax of this configuration file,
# see the file kconfig-language.txt in the NuttX tools repository.
#

config MICROEJ
	bool "microej runtime"
	default n
	---help---
		Enable microej

config MICROEJ_TASK_PRIORITY
	int "microej task priority"
	default 100

config MICROEJ_STACKSIZE
	int "microej stack size"
	default 4096

config MICROEJ_AUDIOPLAYER
    bool "MicroEJ audio library LLAPIs"
    default n
    ---help---
        Enable the C API for the audio library. You need to configure the SDK with the audio player example configuration in order for this to work. The minimal amount of shared memory used by the shared memory mapping for audio functions is 0x80000

config MICROEJ_GNSS
    bool "MicroEJ gnss library LLAPIs"
    default n
    ---help---
        Enable the C API for gnss. You need to configure the SDK with the gnss example for this to work.
```
